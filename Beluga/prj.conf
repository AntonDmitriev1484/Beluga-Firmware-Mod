## CMakeLists.txt
```
#
# Copyright (c) 2021 Nordic Semiconductor ASA
#
# SPDX-License-Identifier: LicenseRef-Nordic-5-Clause
#
cmake_minimum_required(VERSION 3.20.0)
find_package(Zephyr REQUIRED HINTS $ENV{ZEPHYR_BASE})
project(Beluga)

# NORDIC SDK APP START
file(GLOB SOURCE "src/*.c")
set(SERIAL_SRC
        src/serial/comms.c
        src/serial/comms_uart.c)
file(GLOB DECAWAVE_SRC "DecaDriver/src/*.c")
# Added for debugging why the debugger wont work
# add_compile_options(-g -O0)


add_compile_options(-g -ggdb -fno-omit-frame-pointer -fno-inline -fno-optimize-sibling-calls)

include_directories(include DecaDriver/include)

target_sources(app PRIVATE
    ${SOURCE}
    ${SERIAL_SRC}
    ${DECAWAVE_SRC}
)
target_sources_ifdef(CONFIG_MCUMGR_TRANSPORT_COMMS app PRIVATE
        src/serial/smp_comms.c
        src/serial/serial_util.c
)
# NORDIC SDK APP END
```

## prj.conf
```kconfig
#
# Copyright (c) 2021 Nordic Semiconductor ASA
#
# SPDX-License-Identifier: LicenseRef-Nordic-5-Clause
#

# Bluetooth related stuff
CONFIG_NCS_SAMPLES_DEFAULTS=y

CONFIG_BT=y
CONFIG_BT_PERIPHERAL=y
CONFIG_BT_CENTRAL=y
CONFIG_BT_DEVICE_NAME="Beluga"
CONFIG_BT_DEVICE_APPEARANCE=832
CONFIG_BT_MAX_CONN=2
CONFIG_BT_MAX_PAIRED=2
CONFIG_BT_DEVICE_NAME_DYNAMIC=y

CONFIG_BT_SMP=y

CONFIG_BT_SCAN=y
CONFIG_BT_SCAN_FILTER_ENABLE=y
CONFIG_BT_SCAN_UUID_CNT=1

CONFIG_BT_GATT_CLIENT=y
CONFIG_BT_GATT_DM=y

CONFIG_BT_HRS=y
CONFIG_BT_HRS_CLIENT=y

# Settings
# CONFIG_BT_SETTINGS=y # Removing this line fixed kernel startup crash with RTT?
CONFIG_FLASH=y
CONFIG_FLASH_PAGE_LAYOUT=y
CONFIG_FLASH_MAP=y
CONFIG_NVS=y
CONFIG_SETTINGS=y
CONFIG_SETTINGS_RUNTIME=y

# Memory configs
CONFIG_HEAP_MEM_POOL_SIZE=1024
CONFIG_MAIN_STACK_SIZE=2048

# Peripherals
CONFIG_DK_LIBRARY=y
CONFIG_REBOOT=y
CONFIG_GPIO=y
CONFIG_SPI=y
CONFIG_I2C=y
CONFIG_PM_DEVICE=y
CONFIG_POWEROFF=y

# UART driver
CONFIG_UART_INTERRUPT_DRIVEN=y
CONFIG_SERIAL=y
CONFIG_CONSOLE=y
CONFIG_UART_CONSOLE=y

# Config logger
CONFIG_USE_SEGGER_RTT=n 
CONFIG_LOG_BACKEND_UART=y
CONFIG_LOG_MODE_IMMEDIATE=y
CONFIG_LOG_PRINTK=y
CONFIG_BOOT_BANNER=n
CONFIG_NCS_BOOT_BANNER=n

# Floating point support
CONFIG_NEWLIB_LIBC=y
CONFIG_NEWLIB_LIBC_FLOAT_PRINTF=y
CONFIG_NEWLIB_LIBC_NANO=n

# Custom Beluga Settings
CONFIG_ENABLE_BELUGA_THREADS=y
CONFIG_ENABLE_COMMANDS=y
CONFIG_ENABLE_LIST=y
CONFIG_ENABLE_RANGING=y
CONFIG_ENABLE_MONITOR=y
CONFIG_ENABLE_RESPONDER=y
CONFIG_ENABLE_BELUGA_UWB=y
CONFIG_BELUGA_LEDS=y
CONFIG_BELUGA_BLE_LEDS=n
CONFIG_BELUGA_NETWORK_SIZE=3
CONFIG_UWB_LOGIC_CLK=y
CONFIG_JSON_LIBRARY=y

# Thread priorities
CONFIG_BELUGA_COMMANDS_PRIO=7
CONFIG_BELUGA_LIST_PRIO=7
CONFIG_BELUGA_RANGING_PRIO=7
CONFIG_BELUGA_MONITOR_PRIO=7
CONFIG_BELUGA_RESPONDER_PRIO=8

# Thread stack sizes
CONFIG_COMMANDS_STACK_SIZE=3040
CONFIG_LIST_STACK_SIZE=3640
CONFIG_RANGING_STACK_SIZE=1540
CONFIG_MONITOR_STACK_SIZE=3440
CONFIG_RESPONDER_STACK_SIZE=2640

# Watchdog timer
CONFIG_WATCHDOG=y
CONFIG_TASK_WDT=y
CONFIG_WDT_DISABLE_AT_BOOT=n
CONFIG_TASK_WDT_CHANNELS=3
CONFIG_TASK_WDT_HW_FALLBACK=y
CONFIG_TASK_WDT_HW_FALLBACK_DELAY=500

# FEM options
CONFIG_CLOCK_CONTROL_NRF_K32SRC_XTAL=y
CONFIG_CLOCK_CONTROL_NRF_K32SRC_50PPM=y

# Debugging
CONFIG_ASSERT=y
CONFIG_CORTEX_M_DEBUG_MONITOR_HOOK=n
CONFIG_DEBUG_THREAD_INFO=n
CONFIG_SEGGER_DEBUGMON=n
CONFIG_DEBUG_OPTIMIZATIONS=n

# Beluga specific debugging
CONFIG_DEBUG_BELUGA_CLOCK=n
CONFIG_BELUGA_RESET_REASON=n
CONFIG_BELUGA_EVAL_BLE_STRENGTH=n

# Scheduler configurations
CONFIG_TIMESLICING=n
CONFIG_SCHED_DUMB=y

CONFIG_LOG=y
CONFIG_BELUGA_MAIN_LOG_LEVEL_INF=y
CONFIG_LOG_DEFAULT_LEVEL=1
```

## src/main.c
```c
/**
 * @file main.c
 * @brief Main application
 *
 * @date 6/19/2024
 * @author Tom Schmitz
 */

#include <beluga_message.h>
#include <serial/comms.h>

#include <app_leds.h>
#include <app_version.h>
#include <ble_app.h>
#include <debug.h>
#include <initiator.h>
#include <led_config.h>
#include <list_monitor.h>
#include <list_neighbors.h>
#include <range_extension.h>
#include <ranging.h>
#include <responder.h>
#include <settings.h>
#include <spi.h>
#include <stdio.h>
#include <unistd.h>
#include <utils.h>
#include <voltage_regulator.h>
#include <watchdog.h>
#include <cir_buffer.h>
#include <zephyr/kernel.h>
#include <zephyr/logging/log.h>

/**
 * Logger for main
 */
LOG_MODULE_REGISTER(beluga_main, LOG_LEVEL_DBG);//CONFIG_BELUGA_MAIN_LOG_LEVEL);

cir_ring_buffer_t cir_buffer = {0};

/**
 * Prints the settings header if not in frame mode
 *
 * @param[in] _comms Pointer to the comms instance
 */
#define SETTINGS_HEADER(_comms)                                                \
    do {                                                                       \
        if ((_comms)->ctx->format != FORMAT_FRAMES) {                          \
            struct beluga_msg msg = {.type = START_EVENT,                      \
                                     .payload.node_version =                   \
                                         "Node On: " APP_VERSION_STRING};      \
            comms_write_msg(_comms, &msg);                                     \
        }                                                                      \
    } while (0)

/**
 * Prints a formatted settings string
 *
 * @param[in] _comms Pointer to the comms instance
 * @param[in] _str The format string
 * @param[in] ... List of parameters to print
 */
#define _SETTINGS_PRINT_FMT(_comms, _str, ...)                                 \
    do {                                                                       \
        struct beluga_msg msg = {.type = START_EVENT};                         \
        char s[256];                                                           \
        snprintf(s, sizeof(s) - 1, "  " _str, __VA_ARGS__);                    \
        msg.payload.node_version = s;                                          \
        comms_write_msg(_comms, &msg);                                         \
    } while (0)

/**
 * Prints a setting
 *
 * @param[in] _comms Pointer to the comms instance
 * @param[in] _str The settings string
 */
#define __SETTINGS_PRINT(_comms, _str)                                         \
    do {                                                                       \
        struct beluga_msg msg = {.type = START_EVENT,                          \
                                 .payload.node_version = ("  " _str)};         \
        comms_write_msg(_comms, &msg);                                         \
    } while (0)

/**
 * Prints a setting
 *
 * @param[in] _comms Pointer to the comms instance
 * @param[in] _str The setting string to print
 * @param[in] ... Optional list of arguments to print
 */
#define _SETTINGS_PRINT(_comms, _str, ...)                                     \
    COND_CODE_1(IS_EMPTY(__VA_ARGS__), (__SETTINGS_PRINT(_comms, _str)),       \
                (_SETTINGS_PRINT_FMT(_comms, _str, __VA_ARGS__)))

/**
 * Prints a setting if not in frame mode
 *
 * @param[in] _comms Pointer to the comms instance
 * @param[in] _str The setting string to print
 * @param[in] ... Optional list of arguments to print
 */
#define SETTINGS_PRINT(_comms, _str, ...)                                      \
    do {                                                                       \
        if ((_comms)->ctx->format != FORMAT_FRAMES) {                          \
            _SETTINGS_PRINT(_comms, _str, __VA_ARGS__);                        \
        }                                                                      \
    } while (0)

/**
 * Print the node version if in framed mode, otherwise, prints a line break
 * if not in framed mode.
 *
 * @param[in] _comms Pointer to the comms instance
 */
#define SETTINGS_BREAK(_comms)                                                 \
    do {                                                                       \
        if ((_comms)->ctx->format == FORMAT_FRAMES) {                          \
            struct beluga_msg msg = {.type = START_EVENT,                      \
                                     .payload.node_version =                   \
                                         APP_VERSION_STRING};                  \
            comms_write_msg(_comms, &msg);                                     \
        } else {                                                               \
            struct beluga_msg msg = {.type = START_EVENT,                      \
                                     .payload.node_version = "\n"};            \
            comms_write_msg(_comms, &msg);                                     \
        }                                                                      \
    } while (0)

/**
 * Runs a custom print setting routine with arguments
 *
 * @param[in] _comms Pointer to the comms instance
 * @param[in] callback The custom print setting routine to run
 * @param[in] ... Argument list
 */
#define _CUSTOM_INIT_MSG_ARGS(_comms, callback, ...)                           \
    callback(_comms, __VA_ARGS__)

/**
 * Runs a custom print setting routine without arguments
 *
 * @param[in] _comms Pointer to the comms instance
 * @param[in] callback The custom print setting routine to run
 */
#define _CUSTOM_INIT_MSG_NOARGS(_comms, callback) callback(_comms)

/**
 * Runs a custom print setting routine
 *
 * @param[in] _comms Pointer to the comms instance
 * @param[in] callback The custom print setting routine to run
 * @param[in] ... Additional arguments for the routine
 */
#define _CUSTOM_INIT_MSG(_comms, callback, ...)                                \
    COND_CODE_1(IS_EMPTY(__VA_ARGS__),                                         \
                (_CUSTOM_INIT_MSG_NOARGS(_comms, callback)),                   \
                (_CUSTOM_INIT_MSG_ARGS(_comms, callback, __VA_ARGS__)))

/**
 * Runs a custom print setting routine if not in framed mode
 *
 * @param[in] _comms Pointer to the comms instance
 * @param[in] callback The custom print setting routine to run
 * @param[in] ... Additional arguments for the routine
 */
#define CUSTOM_INIT_MSG(_comms, callback, ...)                                 \
    do {                                                                       \
        if ((_comms)->ctx->format != FORMAT_FRAMES) {                          \
            _CUSTOM_INIT_MSG(_comms, callback, __VA_ARGS__);                   \
        }                                                                      \
    } while (0)

/**
 * Load the LED mode from the settings and display the current state
 */
static void load_led_mode(const struct comms *comms) {
    int32_t led_mode = retrieveSetting(BELUGA_LEDMODE);

    if (led_mode == 1) {
        all_leds_off();
    }
    update_led_state(LED_POWER_ON);
    SETTINGS_PRINT(comms, "LED Mode: %d", led_mode);
}

/**
 * Load the node ID from settings and display it
 */
static void load_id(const struct comms *comms) {
    int32_t nodeID = retrieveSetting(BELUGA_ID);

    if (nodeID != DEFAULT_ID_SETTING) {
        update_node_id((uint16_t)nodeID);
        set_initiator_id((uint16_t)nodeID);
        set_responder_id((uint16_t)nodeID);
        SETTINGS_PRINT(comms, "Node ID: %d", nodeID);
    } else {
        SETTINGS_PRINT(comms, "!!!!!!!!!!!!!!!!!!!!!!!!!!!!!!!");
        SETTINGS_PRINT(comms, "!Warning! Please setup node ID!");
        SETTINGS_PRINT(comms, "!!!!!!!!!!!!!!!!!!!!!!!!!!!!!!!");
    }
}

/**
 * Load the mode the node should boot in, update the states for the node, and
 * display the boot mode
 */
static void load_bootmode(const struct comms *comms) {
    int32_t bootMode = retrieveSetting(BELUGA_BOOTMODE);

    switch (bootMode) {
    case 1:
        k_sem_give(&print_list_sem);
        enable_bluetooth();
        update_led_state(LED_BLE_ON);
        break;
    case 2:
        k_sem_give(&print_list_sem);
        enable_bluetooth();
        update_led_state(LED_BLE_ON);
        k_sem_give(&k_sus_resp);
        k_sem_give(&k_sus_init);
        update_led_state(LED_UWB_ON);
    case 0:
        break;
    default:
        SETTINGS_PRINT(comms, "Boot Mode: Unknown");
        break;
    }
    SETTINGS_PRINT(comms, "Boot Mode: %d", bootMode);
}

/**
 * Retrieve the polling rate, set it, and display what it is
 */
static void load_poll_rate(const struct comms *comms) {
    int32_t rate = retrieveSetting(BELUGA_POLL_RATE);

    // Account for new versions of the FW
    if (rate > (int32_t)CONFIG_MAX_POLLING_RATE) {
        rate = CONFIG_MAX_POLLING_RATE;
        updateSetting(BELUGA_POLL_RATE, rate);
    }

    set_rate(rate);
    advertising_reconfig(rate != 0);
    SETTINGS_PRINT(comms, "UWB Polling Rate: %d", rate);
}

/**
 * Retrieve the UWB channel, set it, and display what it is
 */
static void load_channel(const struct comms *comms) {
    int32_t channel = retrieveSetting(BELUGA_UWB_CHANNEL);
    set_uwb_channel(channel);
    SETTINGS_PRINT(comms, "UWB Channel: %d", channel);
}

/**
 * Retrieve the node timeout, set it, and display what it is
 */
static void load_timeout(const struct comms *comms) {
    int32_t timeout = retrieveSetting(BELUGA_BLE_TIMEOUT);
    set_node_timeout(timeout);
    SETTINGS_PRINT(comms, "BLE Timeout: %d", timeout);
}

/**
 * Retrieve the UWB TX power, set it, and display what it is
 */
static void load_tx_power(const struct comms *comms) {
    int32_t tx_power = retrieveSetting(BELUGA_TX_POWER);
    set_tx_power((uint32_t)tx_power);
    CUSTOM_INIT_MSG(comms, print_tx_power, (uint32_t)tx_power);
}

/**
 * Retrieve the neighbor streaming mode, set it, and display the current mode
 */
static void load_stream_mode(const struct comms *comms) {
    int32_t stream_mode = retrieveSetting(BELUGA_STREAMMODE);
    set_stream_mode(stream_mode != 0);
    SETTINGS_PRINT(comms, "Stream Mode: %d", stream_mode);
}

/**
 * Retrieve the two-way ranging mode, set it, and display what it is
 */
static void load_twr_mode(const struct comms *comms) {
    int32_t twr = retrieveSetting(BELUGA_TWR);
    set_twr_mode(twr != 0);
    SETTINGS_PRINT(comms, "Ranging Mode: %d", twr);
}

/**
 * Retrieve the output format mode, set it, and display what it is
 */
static void load_out_format(const struct comms *comms) {
    CUSTOM_INIT_MSG(comms, print_format);
}

/**
 * Retrieve the UWB PHR mode, set it, and display what it is
 */
static void load_phr_mode(const struct comms *comms) {
    int32_t mode = retrieveSetting(BELUGA_UWB_PHR);
    SETTINGS_PRINT(comms, "UWB PHR Mode: %" PRId32, mode);
    uwb_set_phr_mode((enum uwb_phr_mode)mode);
}

/**
 * Retrieve the UWB data rate, set it, and display what it is
 */
static void load_data_rate(const struct comms *comms) {
    enum uwb_datarate rate =
        (enum uwb_datarate)retrieveSetting(BELUGA_UWB_DATA_RATE);
    CUSTOM_INIT_MSG(comms, rate = print_uwb_datarate, rate);
    uwb_set_datarate(rate);
}

/**
 * Retrieve the UWB pulse repetition rate, set it, and display what it is
 */
static void load_pulse_rate(const struct comms *comms) {
    enum uwb_pulse_rate rate =
        (enum uwb_pulse_rate)retrieveSetting(BELUGA_UWB_PULSE_RATE);
    CUSTOM_INIT_MSG(comms, rate = print_pulse_rate, rate);
    uwb_set_pulse_rate((enum uwb_pulse_rate)rate);
}

/**
 * Retrieve the UWB preamble length, set it, and display what it is
 */
static void load_preamble_length(const struct comms *comms) {
    int32_t length = retrieveSetting(BELUGA_UWB_PREAMBLE);
    SETTINGS_PRINT(comms, "UWB Preamble Length: %" PRId32, length);
    uwb_set_preamble((enum uwb_preamble_length)length);
}

/**
 * Retrieve the UWB PAC size, set it, and display what it is
 */
static void load_pac_size(const struct comms *comms) {
    int32_t pac = retrieveSetting(BELUGA_UWB_PAC);
    CUSTOM_INIT_MSG(comms, pac = print_pac_size, pac);
    set_pac_size((enum uwb_pac)pac);
}

/**
 * Retrieve the SFD mode, set it, and display what it is
 */
static void load_sfd_mode(const struct comms *comms) {
    int32_t mode = retrieveSetting(BELUGA_UWB_NSSFD);
    SETTINGS_PRINT(comms, "UWB Nonstandard SFD Length: %" PRId32, mode);
    set_sfd_mode((enum uwb_sfd)mode);
}

/**
 * Retrieve the UWB PAN ID, set it, and display what it is
 */
static void load_pan_id(const struct comms *comms) {
    int32_t pan_id = retrieveSetting(BELUGA_PAN_ID);
    CUSTOM_INIT_MSG(comms, print_pan_id, pan_id);
    set_initiator_pan_id((uint16_t)pan_id);
    set_responder_pan_id((uint16_t)pan_id);
}

/**
 * Retrieve the power amplifier state, set it, and display what it is
 */
UNUSED static void load_power_amplifiers(const struct comms *comms) {
    int ret;
    int32_t pwramp = retrieveSetting(BELUGA_RANGE_EXTEND);

    ret = update_power_mode((enum power_mode)pwramp);

    if (pwramp == 0 || ret != 0) {
        update_led_state(LED_PWRAMP_OFF);
    } else {
        update_led_state(LED_PWRAMP_ON);
    }

    SETTINGS_PRINT(comms, "Range Extension: %d", pwramp);
}

/**
 * Load the format without printing the format value
 * @param[in] comms Pointer to the comms instance
 */
static void load_format_no_msg(const struct comms *comms) {
    int32_t format = retrieveSetting(BELUGA_OUT_FORMAT);
    set_format(comms, (enum comms_out_format_mode)format);
}

#if IS_ENABLED(CONFIG_BELUGA_EVICT_RUNTIME_SELECT)
/**
 * Loads the eviction scheme setting and prints what eviction policy is
 * in use.
 * @param[in] comms Pointer to the comms instance
 */
UNUSED static void load_eviction_scheme(const struct comms *comms) {
    int32_t scheme = retrieveSetting(BELUGA_EVICTION_SCHEME);

    set_node_eviction_policy(scheme);
    CUSTOM_INIT_MSG(comms, print_eviction_scheme);
}
#else
/**
 * Loads the eviction scheme setting and prints what eviction policy is
 * in use.
 * @param[in] comms Pointer to the comms instance
 */
#define load_eviction_scheme(...) (void)0
#endif

/**
 * Load the verbosity setting
 * @param[in] comms Pointer to the comms object
 */
static void load_verbose(const struct comms *comms) {
    int32_t verbose = retrieveSetting(BELUGA_VERBOSE);
    set_verbosity(comms, verbose == 1);
}

/**
 * Load all the settings, initialize all the states, and display what the
 * settings are
 */
static void load_settings(const struct comms *comms) {
    load_format_no_msg(comms);

    SETTINGS_HEADER(comms);
    SETTINGS_PRINT(comms, "Flash Configuration:");

    load_led_mode(comms);
    load_id(comms);
    load_bootmode(comms);

    // Disable UWB LED since setters check LED if UWB is active or not
    enum led_state uwb_state = get_uwb_led_state();
    update_led_state(LED_UWB_OFF);

    // Load UWB settings since ranging task has not started yet
    load_poll_rate(comms);
    load_channel(comms);
    load_phr_mode(comms);
    load_data_rate(comms);
    load_pulse_rate(comms);
    load_preamble_length(comms);
    load_pac_size(comms);
    load_sfd_mode(comms);
    load_pan_id(comms);

    // Restore UWB state in the LEDs
    update_led_state(uwb_state);

    load_timeout(comms);
    load_tx_power(comms);
    load_stream_mode(comms);
    load_twr_mode(comms);
    load_out_format(comms);
    if (IS_ENABLED(CONFIG_BELUGA_RANGE_EXTENSION)) {
        load_power_amplifiers(comms);
    }
    load_eviction_scheme(comms);
    load_verbose(comms);

    SETTINGS_BREAK(comms);
}

/**
 * @brief Main entry point of the application
 * @return 1 on error
 */
int main(void) {
    LOG_ERR("MAIN STARTED");
    const struct comms *comms = comms_backend_uart_get_ptr();
    RESET_CAUSE();

    memset(seen_list, 0, sizeof(seen_list));

    INIT_CLOCKS();

    if (init_voltage_regulator() != 0) {
        LOG_ERR("Failed to initialize voltage regulator");
        return 1;
    }

    if (init_bt_stack() != 0) {
        LOG_ERR("Failed to init bluetooth stack");
        return 1;
    }

    if (initBelugaSettings() != 0) {
        LOG_ERR("Unable to init flash");
        return 1;
    }

    if (init_spi1() < 0) {
        LOG_ERR("Failed to initialize SPI 1");
        return 1;
    }

    if (init_range_extension() != 0) {
        LOG_ERR("Failed to initialize range extension");
        return 1;
    }

    LED_INIT();

    if (configure_watchdog_timer() < 0) {
        LOG_ERR("Failed to configure watchdog timer");
        return 1;
    }

    LOG_INF("Module initialization done. Waiting for DTR to be asserted");
    wait_comms_ready(comms);

    struct task_wdt_attr task_watchdog = {.period = 2000};

    LOG_INF(
        "Spawning a task watchdog timer for starting UWB and loading settings");
    if (spawn_task_watchdog(&task_watchdog) != 0) {
        LOG_ERR("Unable to start watchdog");
        return 1;
    }

    init_uwb();

    load_settings(comms);

    kill_task_watchdog(&task_watchdog);
    LOG_INF("Killed task watchdog. Now running application");

    init_responder_thread();
    init_print_list_task();
    init_ranging_thread();
    init_monitor_thread();

    for (;;) {
        k_sleep(K_FOREVER);
    }

    return 1;
}
```

## include/ble_app.h
```c
/*! ----------------------------------------------------------------------------
 *  @file   ble_app.h
 *
 *  @brief  Nordic BLE advertising and scanning application codes --Header file
 *
 *  @date   2020/07
 *
 *  @author WiseLab-CMU
 */

#ifndef _BLE_APP_
#define _BLE_APP_

#include <stdbool.h>
#include <stdint.h>
#include <zephyr/kernel.h>

#include <deca_device_api.h>

/**
 * Eviction policies for when the neighbor list is full
 */
enum node_eviction_policy {
    EVICT_POLICY_RR = 0,       ///< Index round robin
    EVICT_POLICY_RSSI = 1,     ///< Lowest RSSI
    EVICT_POLICY_RANGE = 2,    ///< Largest range
    EVICT_POLICY_BLE_TS = 3,   ///< Least recently scanned node
    EVICT_POLICY_RANGE_TS = 4, ///< Least recently updated range
    EVICT_POLICY_INVALID       ///< Last enumerator
};

/**
 * BLE neighbor node structure
 */
struct node {
    uint16_t UUID;
    int8_t RSSI;
    int64_t time_stamp;
    float range;
    bool update_flag;
    bool polling_flag;
    int64_t ble_time_stamp;

    uint16_t maxNoise;
    uint16_t firstPathAmp1;
    uint16_t firstPathAmp2;
    uint16_t firstPathAmp3;
    uint16_t stdNoise;
    uint16_t maxGrowthCIR;
    uint16_t rxPreamCount;
    uint16_t firstPath;

        // --- DS-TWR timestamps ---
    uint32_t poll_tx_ts;
    uint32_t poll_rx_ts;
    uint32_t resp_tx_ts;
    uint32_t resp_rx_ts;
    uint32_t final_tx_ts;
    uint32_t final_rx_ts;
    uint32_t report_tx_ts;
    uint32_t report_rx_ts;

#if IS_ENABLED(CONFIG_UWB_LOGIC_CLK)
    uint32_t exchange_id;
#endif
};

/**
 * Neighbor list size
 */
#define MAX_ANCHOR_COUNT CONFIG_BELUGA_NETWORK_SIZE

/**
 * The neighbor list
 */
extern struct node seen_list[MAX_ANCHOR_COUNT];

/**
 * Checks if specified neighbor is in the neighbor list
 * @param[in] uuid The neighbor node ID
 * @return true if in neighbor list
 * @return false if not in neighbor list
 */
bool in_seen_list(uint16_t uuid);

/**
 * Initializes the Bluetooth stack
 * @return 0 upon success
 * @return negative error code otherwise
 */
int init_bt_stack(void);

/**
 * Stops Bluetooth scanning and advertising and unloads the bluetooth stack
 * @return 0 upon success
 * @return negative error code otherwise
 */
int deinit_bt_stack(void);

/**
 * Starts the Bluetooth FEM (if applicable) and starts Bluetooth
 * scanning/advertising
 * @return 0 upon success
 * @return 1 if already on
 * @return -EFAULT if unable to start the FEM
 * @return negative error code otherwise
 */
int enable_bluetooth(void);

/**
 * Stops Bluetooth advertising/scanning and powers down the Bluetooth FEM
 * @return 0 upon success
 * @return 1 if Bluetooth is already off
 * @return -EFAULT if unable to power down the Bluetooth FEM
 * @return negative error code otherwise
 */
int disable_bluetooth(void);

/**
 * Updates the node ID and publishes the update to the Bluetooth advertising
 * data
 * @param[in] uuid The new node ID
 */
void update_node_id(uint16_t uuid);

/**
 * Retrieves the current node ID
 * @return The current node ID
 */
uint16_t get_NODE_UUID(void);

/**
 * Update the advertising data to indicate that the node is polling UWB or not
 * @param[in] change If 0, updates the advertising data to indicate that the
 * node has stopped polling; otherwise, indicates that the node is polling UWB
 */
void advertising_reconfig(int32_t change);

/**
 * Checks if Bluetooth is currently advertising/scanning
 * @return `true` if advertising/scanning
 * @return `false` otherwise
 */
bool check_ble_enabled(void);

/**
 * Returns the current Bluetooth state and disables scanning/advertising.
 * Additionally, blocks other threads from enabling Bluetooth until the state is
 * restored. See `restore_bluetooth()`
 * @return The current Bluetooth state
 */
bool save_and_disable_bluetooth(void);

/**
 * Restores the Bluetooth state to its original setting. Additionally, releases
 * the Bluetooth lock to allow other threads to update the Bluetooth state. See
 * `save_and_disable-bluetooth()`
 * @param[in] state The saved Bluetooth state
 */
void restore_bluetooth(bool state);

#if defined(CONFIG_BELUGA_GATT)
void update_ble_service(uint16_t uuid, float range);
#else
#define update_ble_service(x, y) (void)0
#endif // defined(CONFIG_BELUGA_GATT)

#if defined(CONFIG_BELUGA_EVICT_RUNTIME_SELECT)
/**
 * Updates the eviction policy
 * @param[in] policy The new policy
 */
void set_node_eviction_policy(enum node_eviction_policy new_policy);

/**
 * Prints the eviction policy in human readable text
 * @param[in] comms Pointer to the comms instance
 * @return 0 upon success
 * @return -EINVAL if input parameters are invalid
 * @return -EFAULT if the current eviction policy is unknown
 * @return negative error code otherwise
 */
int print_eviction_scheme(const struct comms *comms);
#else
/**
 * Updates the eviction policy
 * @param[in] policy The new policy
 */
#define set_node_eviction_policy(...) (void)0

/**
 * Prints the eviction policy in human readable text
 * @param[in] comms Pointer to the comms instance
 * @return 0 upon success
 * @return -EINVAL if input parameters are invalid
 * @return -EFAULT if the current eviction policy is unknown
 * @return -ENOTSUP if disabled
 * @return negative error code otherwise
 */
#define print_eviction_scheme(...)    (-ENOTSUP)
#endif

#endif
```

## include/cir_buffer.h
```c
#ifndef CIR_BUFFER_H
#define CIR_BUFFER_H

// 1. System Headers
#include <stdint.h>
#include <stdbool.h>

// 2. Project Headers (use angle brackets for system-like paths)
#include <deca_device_api.h>

// 3. Custom Type Definitions
// Defines a complex number for the CIR data.
typedef struct {
    int16_t real;
    int16_t imag;
} dwt_complex_t;

// 4. Defines
// The number of CIR data sets the buffer can hold. Set to 1 to conserve RAM.
#define CIR_BUFFER_SIZE 1
// The number of CIR samples to capture. Reduced from 1016 to fit in RAM.
#define CIR_SAMPLES_TO_READ 128

// 5. Shared Structure Definition
// This defines the structure of our circular buffer.
typedef struct {
    dwt_complex_t data[CIR_BUFFER_SIZE][CIR_SAMPLES_TO_READ];
    volatile uint8_t head; // Written to by the ISR
    volatile uint8_t tail; // Read from by the application thread
} cir_ring_buffer_t;

// 6. External Variable Declaration
// Announces the global buffer variable exists and will be created elsewhere.
extern cir_ring_buffer_t cir_buffer;

#endif // CIR_BUFFER_H
```

## include/init_resp_common.h
```c
/**
 * @file init_resp_common.h
 * @brief Common definitions and macros for UWB (Ultra-Wideband) ranging.
 *
 * Provides various macros, inline functions, and constants used in the context
 * of UWB ranging communication. The macros define offsets, overheads, and
 * lengths for different parts of a UWB frame, such as frame control, sequence
 * counter, UUIDs, and PAN ID. Inline functions for setting and getting UUIDs,
 * PAN ID, and timestamps in UWB frames are also included.
 *
 * @date 11/21/2024
 * @author Tom Schmitz
 */

#ifndef BELUGA_INIT_RESP_COMMON_H
#define BELUGA_INIT_RESP_COMMON_H

#include <deca_device_api.h>
#include <zephyr/kernel.h>

/**
 * The number of bytes needed for the Frame control
 */
#define FC_OVERHEAD 2

/**
 * The number of bytes needed for the sequence counter
 */
#define SEQ_CNT_OVERHEAD 1

/**
 * Number of bytes needed for the PAN ID
 */
#define PAN_ID_OVERHEAD 2

/**
 * Number of bytes needed for the destination UUID
 */
#define DEST_OVERHEAD 2

/**
 * Number of bytes needed for the source UUID
 */
#define SRCV_OVERHEAD 2

/**
 * Number of bytes needed for the function code
 */
#define FUNC_CODE_OVERHEAD 1

/**
 * Number of bytes needed for the frame checksum
 */
#define CRC_OVERHEAD 2

#if defined(CONFIG_UWB_LOGIC_CLK)
/**
 * Number of bytes needed for the logic clock
 */
#define LOGIC_CLK_OVERHEAD 4
#else
/**
 * Number of bytes needed for the logic clock
 */
#define LOGIC_CLK_OVERHEAD 0
#endif

/**
 * Number of bytes needed for a ranging header
 */
#define DW_HEADER_OVERHEAD                                                     \
    (FC_OVERHEAD + SEQ_CNT_OVERHEAD + PAN_ID_OVERHEAD + DEST_OVERHEAD +        \
     SRCV_OVERHEAD + FUNC_CODE_OVERHEAD + LOGIC_CLK_OVERHEAD)

/**
 * Minimum number of bytes needed for a UWB ranging frame
 */
#define DW_FRAME_OVERHEAD (DW_HEADER_OVERHEAD + CRC_OVERHEAD)

/**
 * The base length of a UWB ranging frame
 */
#define DW_BASE_LEN DW_HEADER_OVERHEAD

/**
 * The number of bytes needed for a timestamp
 */
#define TIMESTAMP_OVERHEAD 4

/**
 * Checks if UWB is active and forces the calling function to return -EBUSY if
 * UWB is active.
 */
#define CHECK_UWB_ACTIVE()                                                     \
    do {                                                                       \
        if (get_uwb_led_state() == LED_UWB_ON) {                               \
            return -EBUSY;                                                     \
        }                                                                      \
    } while (0)

/**
 * Stalls a task until a certain condition is met. Additionally, if curly braces
 * ({}) are used on this like a loop, then code can be ran inside like a loop
 * while the condition is not met.
 *
 * @param[in] cond The condition that needs to be met before continuing
 */
#define UWB_WAIT(cond) while (!(cond))

/**
 * The byte offset of the frame control byte field
 */
#define FC_OFFSET 0

/**
 * The byte offset of the sequence counter byte field
 */
#define SEQ_CNT_OFFSET (FC_OFFSET + FC_OVERHEAD)

/**
 * The byte offset of the PAN ID byte field
 */
#define PAN_ID_OFFSET (SEQ_CNT_OFFSET + SEQ_CNT_OVERHEAD)

/**
 * The byte offset of the destination UUID byte field
 */
#define DEST_OFFSET (PAN_ID_OFFSET + PAN_ID_OVERHEAD)

/**
 * The byte offset of the source UUID byte field
 */
#define SRC_OFFSET (DEST_OFFSET + DEST_OVERHEAD)

/**
 * The byte offset of the function code byte field
 */
#define FUNC_CODE_OFFSET (SRC_OFFSET + SRCV_OVERHEAD)

/**
 * The byte offset of the logic clock byte field
 */
#define LOGIC_CLK_OFFSET (FUNC_CODE_OFFSET + FUNC_CODE_OVERHEAD)

/**
 * The byte offset of the ranging payload
 */
#define DW_BASE_PAYLOAD_OFFSET (LOGIC_CLK_OFFSET + LOGIC_CLK_OVERHEAD)

/**
 * The polling message length
 */
#define POLL_MSG_LEN DW_FRAME_OVERHEAD

/**
 * The response message length
 */
#define RESP_MSG_LEN                                                           \
    (DW_FRAME_OVERHEAD + TIMESTAMP_OVERHEAD + TIMESTAMP_OVERHEAD)

/**
 * The final message length
 */
#define FINAL_MSG_LEN                                                          \
    (DW_FRAME_OVERHEAD + TIMESTAMP_OVERHEAD + TIMESTAMP_OVERHEAD +             \
     TIMESTAMP_OVERHEAD)

/**
 * The report message length
 */
#define REPORT_MSG_LEN (DW_FRAME_OVERHEAD + (5 * TIMESTAMP_OVERHEAD))

/**
 * Index of the polling message receive timestamp
 */
#define RESP_MSG_POLL_RX_TS_IDX DW_BASE_PAYLOAD_OFFSET

/**
 * Index of the response transmit timestamp
 */
#define RESP_MSG_RESP_TX_TS_IDX (DW_BASE_PAYLOAD_OFFSET + TIMESTAMP_OVERHEAD)

/**
 * Index of the final message transmit timestamp
 */
#define FINAL_MSG_FINAL_TX_TS_IDX                                              \
    (DW_BASE_PAYLOAD_OFFSET + TIMESTAMP_OVERHEAD + TIMESTAMP_OVERHEAD)

/**
 * The speed of light in a vacuum in m/s
 */
#define SPEED_OF_LIGHT 299702547

/**
 * UWB microsecond (uus) to device time unit (dtu, around 15.65 ps) conversion
 * factor. 1 uus = 512 / 499.2 ?s and 1 ?s = 499.2 * 128 dtu.
 */
#define UUS_TO_DWT_TIME 65536

/**
 * @Brief Sets the source ID byte field to the specified UUID
 * @param[in] id The new source UUID
 * @param[in,out] buf The frame buffer
 */
static inline void set_src_id(uint16_t id, uint8 *buf) {
    buf[SRC_OFFSET] = (uint8)id;
    buf[SRC_OFFSET + 1] = (uint8)(id >> 8);
}

/**
 * @Brief Sets the destination ID byte field to the specified UUID
 * @param[in] id The new destination UUID
 * @param[in,out] buf The frame buffer
 */
static inline void set_dest_id(uint16_t id, uint8 *buf) {
    buf[DEST_OFFSET] = (uint8)id;
    buf[DEST_OFFSET + 1] = (uint8)(id >> 8);
}

/**
 * @brief Retrieves the source UUID from a frame buffer
 * @param[in] buf The frame buffer
 * @return The received source UUID
 */
static inline uint16_t get_src_id(const uint8 *buf) {
    return ((uint16_t)buf[SRC_OFFSET + 1] << 8) | (uint16_t)buf[SRC_OFFSET];
}

/**
 * @brief Sets the PAN ID byte field to the specified ID
 * @param[in] id The new PAN ID
 * @param[in,out] buf The frame buffer
 */
static inline void set_pan_id(uint16_t id, uint8 *buf) {
    buf[PAN_ID_OFFSET] = (uint8)id;
    buf[PAN_ID_OFFSET + 1] = (uint8)(id >> 8);
}

/*!
 * ------------------------------------------------------------------------------------------------------------------
 * @fn get_rx_timestamp_u64()
 *
 * @brief Get the RX time-stamp in a 64-bit variable.
 *        /!\ This function assumes that length of time-stamps is 40 bits, for
 * both TX and RX!
 *
 * @param  none
 *
 * @return  64-bit value of the read time-stamp.
 */
static inline uint64_t get_rx_timestamp_u64(void) {
    uint8_t ts_tab[5];
    uint64_t ts = 0;
    int i;
    dwt_readrxtimestamp(ts_tab);
    for (i = 4; i >= 0; i--) {
        ts <<= 8;
        ts |= ts_tab[i];
    }
    return ts;
}

/**
 * @brief Get the TX time-stamp in a 64-bit variable.
 *
 * @return 64-bit value of the read time-stamp.
 *
 * @note This function assumes that length of time-stamps is 40 bits, for both
 * TX and RX!
 * @note The function is faster than using memcpy(). Usage of memcpy() will
 * result in a timing error
 */
static inline uint64_t get_tx_timestamp_u64(void) {
    uint8_t ts_tab[5];
    uint64_t ts = 0;
    int i;
    dwt_readtxtimestamp(ts_tab);
    for (i = 4; i >= 0; i--) {
        ts <<= 8;
        ts |= ts_tab[i];
    }
    return ts;
}

/**
 * @brief Read a given timestamp value from the message. In the timestamp fields
 * of the response message, the least significant byte is at the lower address.
 *
 * @param[in] ts_field Pointer on the first byte of the timestamp field to get
 * ts timestamp value
 * @param[in] ts The received timestamp from the ts_field
 *
 * @note The function is faster than using memcpy(). Usage of memcpy() will
 * result in a timing error
 */
static inline void msg_get_ts(const uint8_t *ts_field, uint32_t *ts) {
    int i;
    *ts = 0;
    for (i = 0; i < TIMESTAMP_OVERHEAD; i++) {
        *ts += ts_field[i] << (i * 8);
    }
}

/**
 * @brief Fill a given timestamp field in the response message with the given
 * value. In the timestamp fields of the response message, the least significant
 * byte is at the lower address.
 *
 * @param[in] ts_field Pointer on the first byte of the timestamp field to fill
 * ts timestamp value
 * @param[in] ts The timestamp to fill the timestamp field with
 *
 * @note The function is faster than using memcpy(). Usage of memcpy() will
 * result in a timing error
 */
static inline void msg_set_ts(uint8 *ts_field, const uint64_t ts) {
    int i;
    for (i = 0; i < TIMESTAMP_OVERHEAD; i++) {
        ts_field[i] = (ts >> (i * 8)) & 0xFF;
    }
}

#if defined(CONFIG_UWB_LOGIC_CLK)
/**
 * Set the exchange ID byte field with the given ID
 *
 * @param[in] ts_field Pointer on the first byte of the logic clock field to
 * fill ts logic clock value
 * @param[in] ts The logic clock value
 */
#define SET_EXCHANGE_ID(ts_field, ts) msg_set_ts(ts_field, ts)

/**
 * Retrieve the logic clock value from the exchange ID byte field
 *
 * @param[in] ts_field Pointer on the first byte of the logic clock field to get
 * logic clock value
 * @param[in,out] Pointer to the logic clock variable to update with the
 * ts_field
 */
#define GET_EXCHANGE_ID(ts_field, ts) msg_get_ts(ts_field, &(ts))
#else

/**
 * Set the exchange ID byte field with the given ID
 *
 * @param[in] ts_field Pointer on the first byte of the logic clock field to
 * fill ts logic clock value
 * @param[in] ts The logic clock value
 */
#define SET_EXCHANGE_ID(ts_field, id) (void)0

/**
 * Retrieve the logic clock value from the exchange ID byte field
 *
 * @param[in] ts_field Pointer on the first byte of the logic clock field to get
 * logic clock value
 * @param[in,out] Pointer to the logic clock variable to update with the
 * ts_field
 */
#define GET_EXCHANGE_ID(ts_field, ts) (void)0
#endif // defined(CONFIG_UWB_LOGIC_CLK)

#endif // BELUGA_INIT_RESP_COMMON_H
```

## include/initiator.h
```c
/**
 * @file initiator.h
 *
 * @brief This module implements the functionality for the initiator role in a
 * UWB-based ranging system.
 *
 * The primary objective of this module is to perform the communication sequence
 * required to initiate a ranging process and compute the distance between the
 * initiator and a responder in a UWB-based system.
 *
 * The module handles:
 * - Sending a poll message to the responder.
 * - Receiving a response from the responder.
 * - Sending a final message containing timestamp data (two-way/double-sided
 * ranging only).
 * - Receiving a report message containing the time-of-flight (ToF) data, which
 * is used to calculate the distance (two-way/double-sided ranging only).
 *
 * @date 6/1/2024
 *
 * @author Decawave
 * @author Tome Schmitz
 */

#ifndef BELUGA_INITIATOR_H
#define BELUGA_INITIATOR_H

#include <deca_types.h>
#include <deca_device_api.h>
#include <stdbool.h>
#include <stdint.h>
#include <zephyr/kernel.h>

/**
 * @brief Sets the source IDs for the messages that the initiator sends and the
 * destination ID for the messages the initiator receives
 *
 * @param[in] id The ID of the node
 *
 * @return 0 upon success
 * @return -EBUSY if UWB is active
 */
int set_initiator_id(uint16_t id);

/**
 * @brief Sets the personal area network (PAN) ID for the initiator messages
 *
 * @param[in] id
 * @return 0 upon success
 * @return -EBUSY if UWB is active
 */
int set_initiator_pan_id(uint16_t id);

/**
 * @brief Sets the multiplication factor to convert carrier integrator value to
 * a frequency offset in Hertz depending on the data rate.
 *
 * @param[in] datarate_110k `true` if data rate is 110K, `false` otherwise
 */
void set_freq_offset_multiplier(bool datarate_110k);

/**
 * @brief Sets the multiplication factor to convert frequency offset in Hertz to
 * PPM crystal offset depending on the channel.
 *
 * @param[in] channel The channel being used for UWB
 */
void set_hertz_to_ppm_multiplier(uint8_t channel);

/**
 * @brief Initiates a two-way/double-sided ranging measurement to a certain
 * node.
 *
 * @param[in] id The node to range to
 * @param[out] distance The estimated distance between the nodes
 * @param[out] diag Diagnostic
 * @param[out] logic_clock The ID associated with the successful exchange.
 *
 * @return 0 upon a successful ranging run
 * @return -EINVAL if distance parameter is NULL
 * @return negative error code otherwise
 *
 * @note logic_clock will be updated after a successful two-way/double-sided
 * ranging exchange. If an error occurred, then logic_clock will not be updated
 * and thus will retain its original value. Also, if logic_clock is NULL, it is
 * assumed that the logic_clock output is not desired and the run will still be
 * initiated.
 */
// int ds_init_run(uint16_t id, double *distance, uint32_t *logic_clock);
// int ds_init_run(uint16_t id, double *distance, dwt_rxdiag_t* diag, uint32_t *logic_clock);

typedef struct {
    uint32_t poll_tx_ts;
    uint32_t poll_rx_ts;
    uint32_t resp_tx_ts;
    uint32_t resp_rx_ts;
    uint32_t final_tx_ts;
    uint32_t final_rx_ts;
    uint32_t report_tx_ts;
    uint32_t report_rx_ts;
} ds_twr_timestamps_t;

int ds_init_run(uint16_t id, double *distance, 
    dwt_rxdiag_t* diag, 
    uint32_t *logic_clock,
    ds_twr_timestamps_t* ts);

/**
 * @brief Initiates a single-sided ranging measurement to a certain node.
 *
 * @param[in] id The node to range to
 * @param[out] distance The estimated distance between the nodes
 * @param[out] logic_clock The ID associated with the successful exchange.
 *
 * @return 0 upon a successful ranging run
 * @return -EINVAL if distance parameter is NULL
 * @return negative error code otherwise
 *
 * @note logic_clock will be updated after a successful two-way/double-sided
 * ranging exchange. If an error occurred, then logic_clock will not be updated
 * and thus will retain its original value. Also, if logic_clock is NULL, it is
 * assumed that the logic_clock output is not desired and the run will still be
 * initiated.
 */
int ss_init_run(uint16_t id, double *distance, uint32_t *logic_clock);

/**
 * Semaphore for suspending the initiator task
 */
extern struct k_sem k_sus_init;

#endif // BELUGA_INITIATOR_H
```

## include/ranging.h
```c
/**
 * @file ranging.h
 * @brief Ranging Module for UWB-based Distance Measurement System
 *
 * Implements the logic for the ranging, which supports both
 * single-sided and two-way ranging between nodes in a UWB (Ultra-Wideband)
 * network using the DW1000 chip. The module handles configuration,
 * initialization, and communication between nodes. It includes various
 * functions to configure and control the DW1000's parameters, such as data
 * rate, pulse rate, preamble length, and PAC size.
 *
 * Supports both the initiator and responder tasks, where the initiator
 * sends polling messages and the responder listens for them.
 *
 * @author Tom Schmitz \<tschmitz@andrew.cmu.edu\>
 * @date 7/9/24
 */

#ifndef BELUGA_RANGING_H
#define BELUGA_RANGING_H

#include <deca_regs.h>
#include <serial/comms.h>
#include <stdbool.h>
#include <stdint.h>

/**
 * Maximum transmission power register value
 */
#define TX_POWER_MAX 0x1F1F1F1F

/**
 * @brief Represents the channel delay values for the PGDELAY register.
 *
 * Defines the available channel delays in the PGDELAY register for controlling
 * the timing of signal propagation on different channels. These delays can be
 * used to fine-tune the performance of UWB communication.
 */
enum pgdelay_ch {
    ch1 = TC_PGDELAY_CH1, ///< Channel 1 delay
    ch2 = TC_PGDELAY_CH2, ///< Channel 2 delay
    ch3 = TC_PGDELAY_CH3, ///< Channel 3 delay
    ch4 = TC_PGDELAY_CH4, ///< Channel 4 delay
    ch5 = TC_PGDELAY_CH5, ///< Channel 5 delay
    ch7 = TC_PGDELAY_CH7, ///< Channel 7 delay
};


/**
 * @brief Represents the PHR (Physical Header) modes in UWB communication.
 *
 * Defines the available modes for the Physical Header (PHR) in UWB
 * communication, which determines the format and length of the PHR in the
 * transmitted frames.
 */
enum uwb_phr_mode {
    UWB_PHR_MODE_STD, ///< Standard PHR mode
    UWB_PWR_MODE_EXT  ///< Extended Frames PHR mode
};

/**
 * @brief Represents the data rates supported by the UWB module.
 *
 * Defines the available data rates for communication in the UWB
 * (Ultra-Wideband) network, where each data rate corresponds to a specific
 * speed of transmission between nodes.
 */
enum uwb_datarate {
    UWB_DR_6M8,  ///< 6.8 Mbps
    UWB_DR_850K, ///< 850 kbps
    UWB_DR_110K  ///< 110 kbps
};

/**
 * @brief Represents the Pulse Repetition Rate (PRR) options in UWB
 * communication.
 *
 * Defines the available pulse repetition rates for UWB communication,
 * which determine the frequency at which the pulses are transmitted.
 */
enum uwb_pulse_rate {
    UWB_PR_16M, ///< 16 MHz
    UWB_PR_64M  ///< 64 MHz
};

/**
 * @brief Represents the preamble lengths for UWB communication.
 *
 * Defines the available preamble lengths for Ultra-Wideband (UWB)
 * communication. The preamble length determines the duration of the preamble
 * used in the communication signal, which impacts the range and reliability
 * of the transmission.
 */
enum uwb_preamble_length {
    UWB_PRL_64 = 64,     ///< 64 symbols
    UWB_PRL_128 = 128,   ///< 128 symbols
    UWB_PRL_256 = 256,   ///< 256 symbols
    UWB_PRL_512 = 512,   ///< 512 symbols
    UWB_PRL_1024 = 1024, ///< 1024 symbols
    UWB_PRL_1536 = 1536, ///< 1536 symbols
    UWB_PRL_2048 = 2048, ///< 2048 symbols
    UWB_PRL_4096 = 4096, ///< 4096 symbols
    UWB_PRL_ERROR        ///< Invalid preamble length
};

/**
 * @brief Represents the Pulse Amplitude Code (PAC) sizes for UWB communication.
 *
 * Defines the available PAC sizes for Ultra-Wideband (UWB) communication.
 * The PAC size determines the number of samples in a single pulse, affecting
 * the accuracy and range of the distance measurement.
 */
enum uwb_pac {
    UWB_PAC8,  ///< 8 samples per pulse
    UWB_PAC16, ///< 16 samples per pulse
    UWB_PAC32, ///< 32 samples per pulse
    UWB_PAC64  ///< 64 samples per pulse
};

/**
 * @brief Represents the Start Frame Delimiter (SFD) types in UWB communication.
 *
 * This enum defines the available types of Start Frame Delimiters (SFD) used in
 * Ultra-Wideband (UWB) communication. The SFD is a marker that signals the
 * beginning of a frame in the communication protocol.
 */
enum uwb_sfd {
    UWB_STD_SFD, ///< Standard SFD
    UWB_NSTD_SFD ///< Nonstandard SFD
};

/**
 * @brief Prints the TX power in a non-standard (human readable) format
 * @param[in] tx_power The current TX power
 */
void print_tx_power(const struct comms *comms, uint32_t tx_power);

/**
 * @brief Prints the UWB data rate in a non-standard (human readable) format
 * @param[in] rate The current data rate
 * @return The data rate that was just printed
 */
enum uwb_datarate print_uwb_datarate(const struct comms *comms,
                                     enum uwb_datarate rate);

/**
 * @brief Prints the pulse rate in a non-standard (human readable) format
 * @param[in] rate The current pulse rate
 * @return The pulse rate
 */
enum uwb_pulse_rate print_pulse_rate(const struct comms *comms,
                                     enum uwb_pulse_rate rate);

/**
 * @brief Prints the PAC size in a non-standard (human readable) format
 * @param[in] pac The PAC size
 * @return The PAC size
 */
int32_t print_pac_size(const struct comms *comms, int32_t pac);

/**
 * @brief Prints the current PAN ID in a non-standard (human readable) format
 * @param[in] pan_id The PAN ID to print
 */
void print_pan_id(const struct comms *comms, uint32_t pan_id);

/**
 * @brief Sets the PHR mode for the DW1000
 * @param[in] mode The PHR mode to update
 * @return 0 upon success
 * @return -EINVAL if PHR mode is not valid
 */
int uwb_set_phr_mode(enum uwb_phr_mode mode);

/**
 * @brief Sets the data rate of the DW1000
 * @param[in] rate The new data rate of the DW1000
 * @return 0 upon success
 * @return -EINVAL if data rate is an invalid value
 * @return -EBUSY if UWB is active
 */
int uwb_set_datarate(enum uwb_datarate rate);

/**
 * @brief Sets the DW1000 pulse rate
 * @param[in] rate The pulse rate to of the DW1000
 * @return 0 upon success
 * @return -EINVAL if rate is invalid
 * @return -EBUSY if UWB is active
 */
int uwb_set_pulse_rate(enum uwb_pulse_rate rate);

/**
 * @brief Sets the preamble length of the DW1000
 * @param[in] length The new preamble length of the DW1000
 * @return 0 upon success
 * @return -EINVAL if length is invalid
 * @return -EBUSY if UWB is active
 */
int uwb_set_preamble(enum uwb_preamble_length length);

/**
 * @brief Sets the PAC size of the DW1000
 * @param[in] pac The new PAC size of the DW1000
 * @return 0 upon success
 * @return -EINVAL if PAC size is invalid
 * @return -EBUSY if UWB is active
 */
int set_pac_size(enum uwb_pac pac);

/**
 * @brief Sets the SFD mode of the DW1000
 * @param[in] mode The new SFD mode
 * @return 0 upon success
 * @return -EINVAL upon failure
 * @return -EBUSY if UWB is active
 */
int set_sfd_mode(enum uwb_sfd mode);

/**
 * @brief Sets the UWB channel to use for the DW1000
 * @param[in] channel The new UWB channel
 * @return 0 upon success
 * @return -EINVAL if invalid channel'
 * @return -EBUSY if UWB is active
 */
int set_uwb_channel(uint32_t channel);

/**
 * Sets the ranging mode used by the initiator and responder
 * @param[in] value The ranging mode. If `true`, use two-way ranging, if
 * `false`, use single-sided ranging
 */
void set_twr_mode(bool value);

/**
 * @brief Set the rate the initiator sends polling messages
 * @param[in] rate The new rate the initiator sends polling messages. If 0, then
 * do not send polling messages.
 * @return 0 upon success
 * @return -EINVAL if rate is an invalid value
 */
int set_rate(uint32_t rate);

/**
 * @brief Sets the transmit power of the DW1000
 * @param[in] tx_power The new transmit power of the DW1000
 */
void set_tx_power(uint32_t tx_power);

/**
 * @brief Initialize the DW1000 for ranging.
 *
 * Wakes the DW1000 (if coming out of deep sleep), resets the DW1000, and
 * initializes the DW1000 with default values
 */
void init_uwb(void);

/**
 * @brief Creates the ranging thread and initiates its data
 */
void init_ranging_thread(void);

/**
 * @brief Creates the responder thread and initiates its data
 */
void init_responder_thread(void);

#endif // BELUGA_RANGING_H
```
