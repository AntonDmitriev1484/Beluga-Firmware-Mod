#include <zephyr/dt-bindings/gpio/gpio.h>

/ {
	 vr_adjust: vr_adjust {
		 compatible = "vr-adjust";
		 status = "disabled";
		 gpios = <&gpio1 0 0>;
	 };

//	zephyr,user {
//		wake-source-gpios = <&gpio0 15 0>;
//	};
 };

&uart0 {
	status = "disabled";
};

&dw1000_spi {
    // This adds the STANDARD interrupt property that Zephyr requires.
    // The pin number (&gpio1 13) is taken from your main .dts file.
    irq-gpios = <&gpio1 13 GPIO_ACTIVE_HIGH>;
};